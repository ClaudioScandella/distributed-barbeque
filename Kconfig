## plugins/schedpol/Kconfig
```kconfig
choice
  prompt "Default scheduling policy"
  config BBQUE_SCHEDPOL_DEFAULT_YAMS
    depends on BBQUE_SCHEDPOL_YAMS
    bool "YaMS"
  config BBQUE_SCHEDPOL_DEFAULT_YAMCA
    depends on BBQUE_SCHEDPOL_YAMCA
    bool "YaMCA"
  config BBQUE_SCHEDPOL_DEFAULT_RANDOM
    depends on BBQUE_SCHEDPOL_RANDOM
    bool "Random"
  config BBQUE_SCHEDPOL_DEFAULT_CLOVES
    depends on BBQUE_SCHEDPOL_CLOVES
    bool "Cloves"
  config BBQUE_SCHEDPOL_DEFAULT_TEMPURA
    depends on BBQUE_SCHEDPOL_TEMPURA
    bool "Tempura"
  config BBQUE_SCHEDPOL_DEFAULT_SCALLOP
    bool "Scallop"
    select BBQUE_SCHEDPOL_SCALLOP
  config BBQUE_SCHEDPOL_DEFAULT_GRIDBALANCE
    bool "GridBalance"
    select BBQUE_SCHEDPOL_GRIDBALANCE
  config BBQUE_SCHEDPOL_DEFAULT_PERDETEMP
    depends on BBQUE_SCHEDPOL_PERDETEMP
    bool "Perdetemp"
##NP

endchoice

source barbeque/plugins/schedpol/yams/Kconfig
#source barbeque/plugins/schedpol/yamca/Kconfig
source barbeque/plugins/schedpol/random/Kconfig
source barbeque/plugins/schedpol/cloves/Kconfig
source barbeque/plugins/schedpol/tempura/Kconfig
source barbeque/plugins/schedpol/scallop/Kconfig
source barbeque/plugins/schedpol/gridbalance/Kconfig
source barbeque/plugins/schedpol/perdetemp/Kconfig
```

## plugins/schedpol/contrex/Kconfig
```kconfig
config BBQUE_SCHEDPOL_CONTREX
  bool "Contrex"
  default n
  ---help---
  Description...
```

## plugins/schedpol/emulsion/Kconfig
```kconfig
config BBQUE_RT_SCHEDPOL_EMULSION
  bool "[RT] Emulsion"
  default n
  ---help---
  Description...
```

## plugins/schedpol/yamca/Kconfig
```kconfig
config BBQUE_SCHEDPOL_YAMCA
  bool "YaMCA"
  default n
  ---help---
  YaMCA is the ancient of YaMS..
```

## plugins/schedpol/yams/Kconfig
```kconfig
config BBQUE_SCHEDPOL_YAMS
  bool "YaMS"
  default y
  ---help---
  Single binding domain (e.g. single multi-core CPU) resource allocation
  policy, featuring multiple (weighted) contributions in the AWM evaluation
  and resource binding choice (value, reconfiguration overhead, fairness,
  migration, congestion).
```
