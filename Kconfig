## Kconfig
```kconfig
################################################################################
# Platform Configuration
################################################################################

menu "Platform Setup"

choice
  prompt "Platform Layout Parser"
  config BBQUE_PIL_LEGACY
    bool "Legacy BPL Parser"
    ---help---
    The old parser for BarbequeRTRM Platform Layout files (under pil directory)

  config BBQUE_PIL_LOADER
    bool "Platform Loader"
    ---help---
    The new platform loader for BarbequeRTRM Platform Layout files, that enable also
    multi-systems environment.

endchoice

menu "Platform Loader"
  depends on BBQUE_PIL_LOADER
  source "barbeque/plugins/ploader/Kconfig"
endmenu


menu "Simulated Mode"

config BBQUE_TEST_PLATFORM_DATA
  bool "Use Test Platform Data (TPD)"
  default y if TARGET_ANDROID
  default n
  ---help---
  Build the BarbequeRTRM with support for Test Platform Data.
  When compiled with this option turned on, all the target specific
  platform control facilities are disabled.

  This could be a convenient way to use the BarbequeRTRM for initial
  application development and integration, without worry about daemon
  setup or requiring to run the daemon as root.

endmenu # Simulated mode

################################################################################
# Linux Resource Management
################################################################################

menu "Linux Resource Management"

menu "Linux Control Groups"
depends on !BBQUE_TEST_PLATFORM_DATA

config BBQUE_LINUX_CG_MEMORY
  bool "Memory controller"
  default n
  depends on TARGET_LINUX
  depends on !BBQUE_TEST_PLATFORM_DATA
#  depends on !TARGET_ODROID_XU
  ---help---
  Enable the Control Groups memory controller for enforcing the memory
  assignment control.

config BBQUE_CGROUPS_DISTRIBUTED_ACTUATION
  bool "CGroups handled at RTLIb level"
  default n
  depends on TARGET_LINUX
  depends on !BBQUE_TEST_PLATFORM_DATA
  ---help---
  Control Groups are written by the RTLib rather than the Platform Proxy.
  Indeed, what is written into the CGroups is nonetheless decided by Barbeque.

endmenu # Linux Control Groups


config BBQUE_LINUX_PROC_LISTENER
  bool "Linux Process Listener"
  ---help---
  Enables BarbequeRTRM to monitor the status of other processes running
  on the machine.

  This option is experimental but has no side effect on other running
  processes.


choice
depends on !BBQUE_TEST_PLATFORM_DATA
depends on BBQUE_PIL_LEGACY
  prompt "Memory locality"
  default BBQUE_MEMLOC_L3

  config BBQUE_MEMLOC_L3
    bool "L3 cache"

  config BBQUE_MEMLOC_L2
    bool "L2 cache"

  depends on !BBQUE_TEST_PLATFORM_DATA
  ---help---
  Select the memory locality that the BarbequeRTRM optimization policy should
  take into account to properly perform scheduling and resource allocation
  decisions.
  According to the option selected the resource manager can consider a CPU as
  an entity featuring one or more cores (processing elements), sharing a L3
  cache memory ("socket") or a L2 cache memory ("core").

endchoice # Memory locality

endmenu # Linux Resource Management

################################################################################

menu "Heterogeneous Systems"
depends on !BBQUE_TEST_PLATFORM_DATA

config BBQUE_OPENCL
  bool "OpenCL Run-time Management Support"
  depends on TARGET_LINUX
  depends on !BBQUE_TEST_PLATFORM_DATA
  select EXTERNAL_OPENCL
  default n
  ---help---
  Enable the support for run-time resource management of OpenCL applications.

endmenu # OpenCL Support


################################################################################

menu "Power Management"
depends on !BBQUE_TEST_PLATFORM_DATA
	source "barbeque/bbque/pm/Kconfig"

endmenu # Power Management

################################################################################

menu "Distributed Systems"
  depends on BBQUE_PIL_LOADER

  config BBQUE_DIST_MODE
    bool "Distributed Mode"
    default n
    ---help---
    If enabled, it configures the BarbequeRTRM to control a distributed multi-node
    system.

  choice
    prompt "Distributed Configuration"
    depends on BBQUE_DIST_MODE

    config BBQUE_DIST_HIERARCHICAL
      bool "Hierarchical"
      ---help---
      Master/slave configuration. A master instance of the BarbequeRTRM is responsible
      of driving the decisional process of the instances running on the other system
      nodes.

    config BBQUE_DIST_FULLY
      bool "Fully Distributed"
      ---help
      No master instance expected. Each instance make autonomous choices, eventually
      negotiating the workload distribution among the other peer instances running
      on the other system nodes.

  endchoice

  source "barbeque/plugins/agent_proxy/Kconfig"
  source "barbeque/mpi/Kconfig"

endmenu # Distributed Systems


endmenu # PIL Configuration

################################################################################
# Policies
################################################################################

menu "Optimization Policy"
  source "barbeque/plugins/schedpol/Kconfig"

comment "Advanced Options"

config BBQUE_SP_PARALLEL
  bool "Policy Parallel Execution"
  default y
  ---help---
  If selected enable the multi-threaded/parallel execution of the scheduling policy.
  This in case of policy implementation supporting sequential and parallel
  execution flow. It can be useful to disable this option for debug purpose.

  Select this option if you plan to run the BarbequeRTRM daemon on a multi-core
  host machine.

  If unsure, say Y

config BBQUE_SP_COWS_BINDING
  bool "Co-scheduling Workloads (COWS) binding"
  depends on !BBQUE_OPENCL
  default n
  ---help---
  Enable this option only if the recipes feature information about some
  performance counters based statistics. and the scheduling policy implements
  the support to exploit such information. This potentially leads to a more
  effective binding (i.e. selection of the resource domain of the AWM) in order
  to establish whether it is better to co-schedule applications on the same
  resource binding domain (e.g., CPU node) or spread them among different
  domains.

  If unsure, say N

endmenu

################################################################################
# Recipe loader
################################################################################

menu "Recipe Loader"
  source "barbeque/plugins/rloader/Kconfig"
endmenu


################################################################################
# RTLib
################################################################################

menu "Run-Time Library (RTLib)"

choice
  prompt "RPC Channel"

  config BBQUE_RPC_FIFO
    bool "FIFO based"
    ---help---
    Use the FIFO based RPC channel

endchoice

config BBQUE_RPC_TIMEOUT
  int "RPC Channel Timeout"
  default 5000
  ---help---
  The amount of time (in seconds) after which a not responding application
  must be considered disabled.

config BBQUE_RTLIB_PERF_SUPPORT
  bool "Performance Counters Profiling Support"
  depends on TARGET_LINUX
  default y
  ---help---
  Build the Run-Time Library (RTLib) with support for Performance Counters.
  These counters allows an application, which has been integrated with the
  RTLib, to collect transparently a set of profiling information related
  to the run-time execution.

  This option is useful to port easily the RTLib on platforms not supporting
  performance counters, such as some Android devices with older kernels.

config BBQUE_RTLIB_CGROUPS_SUPPORT
  bool "CGroups Profiling Support"
  depends on TARGET_LINUX
  depends on !BBQUE_TEST_PLATFORM_DATA
  default n if BBQUE_TEST_PLATFORM_DATA
  default y
  ---help---
  Build the Run-Time Library (RTLib) with support for CGroups.
  This framework allows an application, which has been integrated with the
  RTLib, to collect transparently a set of profiling information related
  to the run-time execution.

  This option is useful to port easily the RTLib on platforms not supporting
  or using CGroups for run-time resources management, such as some Android
  devices.

config BBQUE_RTLIB_UNMANAGED_SUPPORT
  bool "Unmanaged Applications Support"
  depends on TARGET_LINUX
  default y
  ---help---
  Build the Run-Time Library (RTLib) with support for UNMANAGED applications.

  An application running in UNMANAGED mode is not controlled by the BarbequRTRM and
  its automatically configured by the RTLib to run in AWM 0 (by default).
  Once this support is enabled, an application could be executed un UNMANAGED mode
  by setting the "U" flag in the BBQUE_RTLIB_OPTS environment variable.
  Such flag could be followed by the ID of the AWM the application should be configured
  to run into, for example:
    BBQUE_RTLIB_OPTS="U3"
  will run the application in AWM 3.

  This option is useful to run applications without BarbequeRTRM control, for example to
  easily support Design Space Exploration (DSE) or the initial development stages of
  a new application.

  Say NO to this option if unsure.

menu "Performance API Configuration"

config BBQUE_RTLIB_RTPROF_REARM_TIME_MS
  int "Runtime Profiles Forwarding Rearm Time [ms]"
  default 1000
  ---help---
  Each time the Runtime Library forwards a runtime profile to the BarbequeRTRM,
  the forwarding is inhibited to avoid high forwarding rates. By changing
  this option, the inhibition time can be changed. Note that the value is
  expressed in milliseconds.

config BBQUE_RTLIB_RTPROF_WAIT_FOR_SYNC_MS
  int "Runtime Profiles Forwarding Wait For Sync Time [ms]"
  default 5000
  ---help---
  Each time the Runtime Library forwards a runtime profile to the BarbequeRTRM,
  the forwarding is inhibited until the BarbequeRTRM modifies the resource allocation.
  If the BarbequeRTRM does not change the allocation for a certain period of time,
  the Runtime Library become once again able to forward runtime profiles.

endmenu # Performance

comment "Advanced Options"

config BBQUE_YM_SYNC_FORCE
  bool "Synchronization Point forcing"
  default n
  ---help---
  Enable the Sync Point forcing via Synchronization Manager and RTLib.

  By selecting this option, the Synchronization Manager (YM) enforce EXCs
  reconfiguration to be aligned with the synchronization latency defined by
  applications being reconfigured.
  The synchronization latency is the time delay required by an application to
  be in a synchronization point, i.e. complete the current run and being ready
  to start a new one.

  In general this option could be keept disabled, since it is mandatory just
  on few specific platforms and programming paradigms combinations.
  Specifically, it should be explicitly enabled just when a resource
  contention treat could be expected on a specific target platform or
  programming paradigm.

  NOTE: disabling Sync Point Enforcing is corrently not completely safe and
        could lead to a reconfiguration miss for some applications.
        Use this feature at your own risk.

  If unsure, select N

config BBQUE_YP_SASB_ASYNC
  bool "Parallel Re-configurations"
  default n if TARGET_ANDROID
  default y
  ---help---
  Build the SASM policy with support for asynchronous protocol calls.

  By selecting this option, the synchronization protocol is executed with
  asynchronous calls which means that the interaction with applications to be
  re-configured is parallelized, i.e. each protocol requets is managed by a
  dedicated thread and all them runs in parallel.

  Select this option if you plan to run the BarbequeRTRM daemon on a multi-core
  host machine and with a average high number of concurrent applications.

  If unsure, select Y. Select N for Android targets.

endmenu # RTLib Configuration

################################################################################
# Advanced Options
################################################################################

menu "Advanced Options"

config BBQUE_BUILD_DEBUG
  bool "Build DEBUG version"
  default n
  ---help---
  Build the BarbequeRTRM with DEBUGGING support enabled.

  This will produce a version of both the daemon and the RTLib with much more
  logging messages and debug symbols, which is suitable for debugging purposes.

config BBQUE_APP_PRIO_LEVELS
  int "Number of Priority Levels"
  default 5
  ---help---
  Applications are scheduled according to their priority which is a value
  ranging from 0 (highest priority) to a defined minimum value.

  Recipies define the priority of the corresponding Application.

config BBQUE_RESOURCE_MAX_NUM
  int "Number of Resources per Type"
  default 16
  ---help---
  The maximum number of resources per resource type.

  For example, the maximum number of processing elements (computing cores)
  available per processor.


config BBQUE_SCHED_PROFILING
  bool "Scheduling Profiling"
  default n
  ---help---
  Enable the scheduling profiling support

  This will collect statistics about the resource allocation metrics (e.g.,
  mean and variance of the AWM from the scheduled applications, fairness
  index, etc...)

config BBQUE_BUILD_TESTS
  bool "Build the TEST suite"
  default n
  ---help---
  Build the BarbequeRTRM test suite.

  This will build also the set of regression tests used to verify framework
  stability during development.
  NOTE: this is an experimental and not completed feaure, leave un-selected is
  unsure.

config BBQUE_EM
  bool "Event Manager"
  default n
  ---help---
  Build the BarbequeRTRM with support for Event Management (EM).

  The Event Manager is a component for tracing internal BarbequeRTRM events.
  The events archive can be then plotted by using the Event Viewer tool.

  If unsure say no, this will disable all the EM related features.



endmenu # Advanced options
```

## config/templates/cpp/Kconfig
```kconfig
config CONTRIB_MYAPP
  bool "MyApp"
  select CONTRIBS
  default n
  ---help---
  Build the MyApp application.
  
  Insert here a description of this application.

  If unsure, say No to this option.
```

## plugins/agent_proxy.old/Kconfig
```kconfig
config BBQUE_AGENT_PROXY_PORT_DEFAULT
  int "Server port"
  depends on BBQUE_DIST_MODE
  default 885
  ---help---
  The default port number for the AgentProxy server.


choice
  prompt "Agent Proxy plugin"
  depends on BBQUE_DIST_MODE

  config BBQUE_AGENT_PROXY_DEFAULT_GRPC
    depends on BBQUE_AGENT_PROXY_GRPC
    bool "gRPC"

##NP

endchoice

source barbeque/plugins/agent_proxy/grpc/Kconfig
```

## plugins/agent_proxy.old/grpc/Kconfig
```kconfig
config BBQUE_AGENT_PROXY_GRPC
  bool "gRPC Agent Proxy"
  depends on BBQUE_DIST_MODE
  select EXTERNAL_GRPC
  default y
  ---help---
  The AgentProxy plugin based on the gRPC library by Google Inc.
```

## plugins/rpc/Kconfig
```kconfig
config BBQUE_RPC_PUBLIC_CHANNEL
  string
  default "rpc_fifo" if BBQUE_RPC_FIFO

choice
  prompt "Default RPC channel interface"
  config BBQUE_RPC_DEFAULT_FIFO
    bool "FifoRPC"
    select BBQUE_RPC_FIFO
  config BBQUE_RPC_DEFAULT_SERIAL
    bool "Serial"
    select BBQUE_RPC_SERIAL
##NP

endchoice

source barbeque/plugins/rpc/fifo/Kconfig
source barbeque/plugins/rpc/serial/Kconfig
```

## plugins/rpc/fifo/Kconfig
```kconfig
config BBQUE_RPC_FIFO
    bool "FIFO based"
    ---help---
    Use the FIFO based RPC channel
```

## plugins/rpc/serial/Kconfig
```kconfig
config BBQUE_RPC_SERIAL
  bool "Serial"
  default n
  ---help---
  RPC plugin based on Fifo channel and Boost Serialization API.
```
